
&i2c2 {
	status = "okay";
	clock-frequency = <3200000>;
	atmel_mxt_ts@4b {
		compatible = "atmel,atmel_mxt_ts";
		#address-cells = <1>;
		#size-cells = <0>;
		reg = <0x4b>;
		atmel,reset-gpio = <&gpio1 28 0x00>;
		atmel,irq-gpio = <&gpio1 16 0x00>;
		atmel,suspend-mode = <0x02>;
		atmel,input_name = "SSLUK maXTouch Touchscreen";
	};
};

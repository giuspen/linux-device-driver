
&am33xx_pinmux {
	spi0_pins_s0: spi0_pins_s0 {
		pinctrl-single,pins = <
			0x150 0x30 /* spi0_sclk, INPUT_PULLUP | MODE0 */
			0x154 0x30 /* spi0_d0, INPUT_PULLUP | MODE0 */
			0x158 0x10 /* spi0_d1, OUTPUT_PULLUP | MODE0 */
			0x15c 0x10 /* spi0_cs0, OUTPUT_PULLUP | MODE0 */
		>;
	};
};

&spi0 {
	status = "okay";
	pinctrl-names = "default";
	pinctrl-0 = <&spi0_pins_s0>;

	atmel_mxt_ts: atmel_mxt_ts@0 {
		status = "okay";
		compatible = "atmel,atmel_mxt_ts";
		#address-cells = <1>;
		#size-cells = <0>;
		atmel,reset-gpio = <&gpio1 28 0x00>;
		atmel,irq-gpio = <&gpio1 16 0x00>;
		atmel,suspend-mode = <0x02>;
		atmel,input_name = "SSLUK maXTouch Touchscreen";
		spi-max-frequency = <400000>;
		reg = <0>;
		spi-cpol;
		spi-cpha;
	};
};
